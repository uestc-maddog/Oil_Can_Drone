/*===========================================================================
* 网址 ：http://www.cdebyte.com/   http://yhmcu.taobao.com/                 *
* 作者 ：李勇  原 亿和电子工作室  现 亿佰特电子科技有限公司                 * 
* 邮件 ：yihe_liyong@126.com                                                *
* 电话 ：18615799380                                                        *
============================================================================*/

#include "bsp.h"         

// 常量定义
#define TX              1       // 发送模式
#define RX              0       // 接收模式
    
#define ACK_LENGTH      10      // 应答信号长度   
#define SEND_LENGTH     10      // 发送数据每包的长度

INT8U   Cnt1ms = 0;             // 1ms计数变量，每1ms加一                
INT16U  RecvCnt = 0;            // 计数接收的数据包数                

// 需要应答的数据
INT8U   AckBuffer[ACK_LENGTH] = { 10, 11, 12, 13, 14, 15, 16, 17, 18, 19 };

/*===========================================================================
* 函数 : DelayMs() => 延时函数(ms级)                                        *
* 输入 ：x, 需要延时多少(0-255)                                             *
============================================================================*/
void DelayMs(INT8U x)
{
    Cnt1ms = 0;
    while (Cnt1ms <= x);
}

/*===========================================================================
* 函数 ：TIM3_1MS_ISR() => 定时器3服务函数, 定时时间基准为1ms               *
============================================================================*/
void TIM3_1MS_ISR(void)
{
    Cnt1ms++;
}

/*===========================================================================
* 函数 ：MCU_Initial() => 初始化CPU所有硬件                                 *
* 说明 ：关于所有硬件的初始化操作，已经被建成C库，见bsp.c文件               *
============================================================================*/
void MCU_Initial(void)
{
    SClK_Initial();         // 初始化系统时钟，16M     
    GPIO_Initial();         // 初始化GPIO   LED KEY  
    UART_Initial();         // 初始化UART
    TIM3_Initial();         // 初始化定时器3，基准1ms  
    SPI_Initial();          // 初始化SPI               

    enableInterrupts();     // 打开总中断              
}

/*===========================================================================
* 函数 ：RF_Initial() => 初始化RF芯片                                       *
* 输入 ：mode, =0,接收模式， else,发送模式                                  *
* 说明 ：CC1101的操作，已经被建成C库，见CC1101.c文件， 提供SPI和CSN操作，	*
         即可调用其内部所有函数用户无需再关心CC1101的寄存器操作问题。       *
============================================================================*/
void RF_Initial(INT8U mode)
{
    CC1101Init();                                       // 初始化L01寄存器
    if (RX == mode)     { CC1101SetTRMode(RX_MODE); }   // 接收模式              
}

/*===========================================================================
* 函数: System_Initial() => 初始化系统所有外设                              *
============================================================================*/
void System_Initial(void)
{
    MCU_Initial();      // 初始化CPU所有硬件
    RF_Initial(RX);     // 初始化无线芯片,发送模式           
}

/*===========================================================================
* 函数 ：RF_RecvHandler() => 无线数据接收处理                               * 
============================================================================*/
void RF_RecvHandler(void)
{
    INT8U error=0, i=0, length=0, recv_buffer[65]={ 0 };
    
    CC1101SetTRMode(RX_MODE);           // 设置RF芯片接收模式，接收数据
    
    if (0 == CC_IRQ_READ())             // 检测无线模块是否产生接收中断 
    {
        while (CC_IRQ_READ() == 0);

        // 数据请零，防止误判断
        for (i=0; i<SEND_LENGTH; i++)   { recv_buffer[i] = 0; } 
            
        // 读取接收到的数据长度和数据内容
        length = CC1101RecPacket(recv_buffer);
       
        // 判断数据是否有误，接收到的信号应该为0-9
        for (i=0, error=0; i<10; i++)
        {
            if (recv_buffer[i] != i)    { error=1; break; } // 数据出错
        }

        if ((length==10) && (error==0))                     // 数据正确
        {
            LED_TOG();                              // LED闪烁，指示收到正确数据
            DelayMs(10);
            
//            CC1101SetTRMode(TX_MODE);   // 发送应答信号
            CC1101SendPacket(AckBuffer, ACK_LENGTH, ADDRESS_CHECK);
            
            RecvCnt++; 
            LCD_LenDisplay(RecvCnt);    // 更新显示   
        }
        
//        CC1101SetTRMode(RX_MODE);           // 设置RF芯片接收模式，接收数据
    }    
}

/*===========================================================================
* 函数 : main() => 主函数，程序入口                                         *
* 说明 ：每1s发送一包数据，每包数据长度为10个字节，数据内容为0-9            *
         接收方反馈(应答)的数据长度为10个字节，数据内容为10-19              *
============================================================================*/
void main(void)
{
	System_Initial();       // 初始化系统所有外设               

	while (1)
	{
	    RF_RecvHandler();   // 无线数据接收处理               
	}
}





